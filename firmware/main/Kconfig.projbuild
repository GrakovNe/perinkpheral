## firmware/main/Kconfig.projbuild
```kconfig
menu "perINKpheral"

    config APP_DEV_CONSOLE
        bool "Development tools: the USB console and /api/dev"
        default y
        help
            The device can be driven and looked at without hands on it:
            characters typed into the USB console and requests to /api/dev
            press buttons, give the frame the panel shows, open an
            application and take a new build of one. Turn it off for a
            release.

    config APP_BUNDLE_APPS
        bool "Preinstall the applications of firmware/preinstalled.properties"
        default y
        help
            The image of the "apps" partition, which a first flash writes,
            carries the catalog applications the list names, as the catalog
            repository has them at the commit it pins; the build fetches
            them, or reads them from a checkout (PERINKPHERAL_APPS). Turn it
            off for an image with no applications: the partition is then
            written empty and the menu has only the system's own pages.

    menu "Board"

        config APP_ANTENNA_EXTERNAL
            bool "Use the external (U.FL) antenna instead of the ceramic one"
            default n

    endmenu

    menu "e-Paper"

        config APP_EPD_MOSI_GPIO
            int "DIN (MOSI) GPIO"
            default 18

        config APP_EPD_SCLK_GPIO
            int "CLK GPIO"
            default 19

        config APP_EPD_CS_GPIO
            int "CS GPIO"
            default 17

        config APP_EPD_DC_GPIO
            int "DC GPIO"
            default 23

        config APP_EPD_RST_GPIO
            int "RST GPIO"
            default 22

        config APP_EPD_BUSY_GPIO
            int "BUSY GPIO"
            default 16
            help
                GPIO16 is UART0 TX on the ESP32-C6: the ROM prints its
                boot log into this line at every reset. The console must
                stay on USB-JTAG.

    endmenu

    menu "Buttons"

        config APP_BTN1_GPIO
            int "Button 1 GPIO (active low)"
            default 0

        config APP_BTN2_GPIO
            int "Button 2 GPIO (active low)"
            default 1

        config APP_BTN3_GPIO
            int "Button 3 GPIO (active low)"
            default 2

        config APP_BTN4_GPIO
            int "Button 4 GPIO (active low)"
            default 21

        config APP_BTN_DEBOUNCE_MS
            int "Debounce, ms (sampled every 5 ms)"
            range 5 100
            default 20

        config APP_BTN_LONG_MS
            int "A press this long is a long press, ms"
            range 200 5000
            default 600

    endmenu

endmenu
```

## recovery/main/Kconfig.projbuild
```kconfig
# SPDX-License-Identifier: MIT
menu "Recovery"
    config APP_ANTENNA_EXTERNAL
        bool "External antenna"
        default n
    config APP_EPD_MOSI_GPIO
        int
        default 18
    config APP_EPD_SCLK_GPIO
        int
        default 19
    config APP_EPD_CS_GPIO
        int
        default 17
    config APP_EPD_DC_GPIO
        int
        default 23
    config APP_EPD_RST_GPIO
        int
        default 22
    config APP_EPD_BUSY_GPIO
        int
        default 16
endmenu
```
